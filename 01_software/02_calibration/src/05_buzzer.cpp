#include "01_includes.h"

// ===========================================================================
void buzzer_init() {
// ===========================================================================
  pinMode(CONFIG_PIN_BUZZER, OUTPUT);
  digitalWrite(CONFIG_PIN_BUZZER, LOW);
}

// ===========================================================================
void playTone(int32_t freq, int32_t duration, int32_t pause) {
// ===========================================================================
  
  // ?????????????????????????????
  // return;
  // ?????????????????????????????

  if (freq <= 0) {
    delay(duration);
    return;
  }
  
  pinMode(CONFIG_PIN_BUZZER, OUTPUT);
  
  int32_t period = 1000000 / freq;
  int32_t pulseWidth = period / 2;
  int32_t elapsedTime = 0;
  int32_t durationMicros = duration * 1000L; 
  
  while (elapsedTime < durationMicros) {
    digitalWrite(CONFIG_PIN_BUZZER, HIGH);
    delayMicroseconds(pulseWidth);
    digitalWrite(CONFIG_PIN_BUZZER, LOW);
    delayMicroseconds(pulseWidth);
    elapsedTime += period;
  }
  
  if (pause > 0) {
    delay(pause);
  }  
}

// ===========================================================================
void buzzer_beep() {
// ===========================================================================
  // Happy ascending triple beep
  playTone(CONFIG_BUZZER_FREQ, 50, 0);  // C5  
}

// --------------------------
// PREDEFINED SOUND PATTERNS
// --------------------------

// ===========================================================================
void buzzer_soundOK() {
// ===========================================================================
  
  buzzer_beep();
}

// ===========================================================================
void buzzer_soundError() {
// ===========================================================================
  buzzer_beep();
}

// ===========================================================================
void buzzer_soundWarning() {
// ===========================================================================
 buzzer_beep();
}

// ===========================================================================
void buzzer_soundStartup() {
// ===========================================================================
  buzzer_beep();
}

// ===========================================================================
void buzzer_soundButtonPress() {
// ===========================================================================
  buzzer_beep();
}

// ===========================================================================
void buzzer_soundAlert() {
// ===========================================================================
  buzzer_beep();
}

// --------------------------
// DEMONSTRATION LOOP
// --------------------------

// ===========================================================================
void buzzer_soundConnected() {
// ===========================================================================
  buzzer_beep(); 
}

// ===========================================================================
void buzzer_soundDisConnected() {
// ===========================================================================
  buzzer_beep();
}

// ===========================================================================
void buzzer_demo() {
// ===========================================================================
  buzzer_soundStartup();
  delay(1000);
  
  buzzer_soundOK();
  delay(1000);
  
  buzzer_soundWarning();
  delay(1000);
  
  buzzer_soundError();
  delay(1000);
  
  buzzer_soundAlert();
  delay(2000);
}